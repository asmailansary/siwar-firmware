## CMakeLists.txt
```
cmake_minimum_required(VERSION 3.20.0)

find_package(Zephyr REQUIRED HINTS $ENV{ZEPHYR_BASE})
project(siwar_firmware)

target_sources(app PRIVATE
  src/main.c
  src/state.c
  src/ui.c
  src/alert.c
  src/family.c
)
```

## Kconfig
```
menu "Siwar - National Alert Band"

config SIWAR_SCREEN_TIMEOUT_S
	int "Seconds the screen stays on after a button press"
	default 10

config SIWAR_CLEAR_HOLD_S
	int "Seconds the green all-clear light stays on"
	default 180

config SIWAR_MAX_FAMILY
	int "Maximum number of family members"
	default 10

config SIWAR_CBS_CHANNELS
	string "Cell Broadcast message IDs to listen to"
	default "4352-4399"
	help
	  Public warning (PWS/ETWS/CMAS) message ID range. The exact IDs used by
	  the Saudi national early-warning system must be confirmed with the
	  authorities and adjusted here.

config SIWAR_DEV_FAMILY_PHONE
	string "Development only: a family phone number added on first boot"
	default ""

config SIWAR_DEV_FAMILY_NAME
	string "Development only: display name for the development family number"
	default "Family"

endmenu

source "Kconfig.zephyr"
```

## west.yml
```
# نظام السوار الوطني - ملف تعريف المشروع لأداة west
# يعتمد على nRF Connect SDK من شركة Nordic (صانعة شريحة السوار nRF9151)
manifest:
  remotes:
    - name: ncs
      url-base: https://github.com/nrfconnect
  projects:
    - name: nrf
      remote: ncs
      repo-path: sdk-nrf
      revision: v2.9.0
      import: true
  self:
    path: siwar-firmware
```

## prj.conf
```kconfig
# ---- السجلات (للتطوير)
CONFIG_LOG=y

# ---- الأزرار والإضاءة (لوحة التطوير)
CONFIG_DK_LIBRARY=y

# ---- الشبكة الخلوية والإنذار والرسائل
CONFIG_NRF_MODEM_LIB=y
CONFIG_LTE_LINK_CONTROL=y
CONFIG_AT_MONITOR=y
CONFIG_SMS=y

# ---- حفظ قائمة الأهل داخل السوار
CONFIG_FLASH=y
CONFIG_FLASH_MAP=y
CONFIG_NVS=y
CONFIG_SETTINGS=y
CONFIG_SETTINGS_NVS=y

# ---- الذاكرة
CONFIG_HEAP_MEM_POOL_SIZE=4096
CONFIG_MAIN_STACK_SIZE=4096
CONFIG_SYSTEM_WORKQUEUE_STACK_SIZE=4096
```

## src/main.c
```c
/*
 * السوار الوطني - نظام السوار
 * فكرة وابتكار: إسماعيل النجار الأنصاري. جميع الحقوق محفوظة.
 *
 * ترتيب التشغيل:
 *   ١. الواجهة (الأزرار والضوء)
 *   ٢. شريحة الاتصال والاتصال بالشبكة
 *   ٣. قائمة الأهل والرسائل
 *   ٤. استقبال الإنذار الوطني
 */
#include <zephyr/kernel.h>
#include <zephyr/logging/log.h>
#include <modem/nrf_modem_lib.h>
#include <modem/lte_lc.h>

#include "state.h"
#include "ui.h"
#include "alert.h"
#include "family.h"

LOG_MODULE_REGISTER(main, LOG_LEVEL_INF);

static void lte_handler(const struct lte_lc_evt *const evt)
{
	if (evt->type == LTE_LC_EVT_NW_REG_STATUS) {
		bool on = evt->nw_reg_status == LTE_LC_NW_REG_REGISTERED_HOME ||
			  evt->nw_reg_status == LTE_LC_NW_REG_REGISTERED_ROAMING;

		LOG_INF("Network: %s", on ? "connected" : "searching");
	}
}

int main(void)
{
	LOG_INF("Siwar national alert band starting");

	if (ui_init()) {
		LOG_ERR("UI init failed");
	}
	state_init();

	int err = nrf_modem_lib_init();

	if (err) {
		LOG_ERR("Modem init failed (%d)", err);
		return 0;
	}

	err = lte_lc_connect_async(lte_handler);
	if (err) {
		LOG_ERR("LTE connect failed (%d)", err);
	}

	family_init();
	alert_init();

	LOG_INF("Ready. Hold both buttons 3 s for a test alert.");
	return 0;
}
```

## src/alert.c
```c
/*
 * السوار الوطني - استقبال الإنذار الوطني
 *
 * الفكرة: نطلب من شريحة الاتصال أن تستقبل رسائل البث الخلوي على قنوات
 * الإنذار العام (AT+CSCB)، ثم نراقب الإشعار القياسي +CBM الذي يصل عند
 * وصول رسالة بث (المعيار 3GPP TS 27.005).
 *
 * ⚠️ أهم شيء نتحقق منه أول ما يصل الجهاز:
 *   هل شريحة nRF9151 تدعم AT+CSCB وتُرسل +CBM؟
 *   إن لم تدعمه، نغيّر الشريحة كما في ملف المواصفات (البند الإلزامي).
 *
 * TODO: التفريق بين «إنذار» و«زوال الخطر» يعتمد على أرقام الرسائل
 * والمحتوى المستخدم في منظومة الإنذار الوطنية، ويُضبط بعد التنسيق مع الجهات.
 */
#include <stdio.h>
#include <string.h>
#include <zephyr/kernel.h>
#include <zephyr/logging/log.h>
#include <modem/at_monitor.h>
#include <nrf_modem_at.h>

#include "alert.h"
#include "state.h"

LOG_MODULE_REGISTER(alert, LOG_LEVEL_INF);

static void cbs_handler(const char *notif);

AT_MONITOR(cbs_monitor, "+CBM", cbs_handler);

static void cbs_handler(const char *notif)
{
	LOG_WRN("Cell Broadcast received: %s", notif);

	/* TODO: قراءة رقم الرسالة من الإشعار وتحديد نوعها.
	 * مبدئيًا: أي رسالة على قنوات الإنذار = إنذار.
	 */
	state_post_simple(EV_ALERT);
}

int alert_init(void)
{
	/* تفعيل استقبال قنوات الإنذار */
	int err = nrf_modem_at_printf("AT+CSCB=0,\"%s\"", CONFIG_SIWAR_CBS_CHANNELS);

	if (err) {
		LOG_ERR("Modem refused AT+CSCB (%d). Cell Broadcast may not be supported.", err);
		LOG_ERR("Use the two-button test (hold 3 s) until this is resolved.");
		return err;
	}
	LOG_INF("Listening for national alerts on channels %s", CONFIG_SIWAR_CBS_CHANNELS);
	return 0;
}
```

## src/alert.h
```c
/*
 * السوار الوطني - استقبال الإنذار الوطني عبر البث الخلوي (Cell Broadcast)
 */
#ifndef SIWAR_ALERT_H
#define SIWAR_ALERT_H

int alert_init(void);

#endif
```

## src/family.c
```c
/*
 * السوار الوطني - قائمة الأهل ورسائل «أنا بأمان»
 *
 * - القائمة محفوظة داخل السوار (تبقى بعد إطفائه).
 * - «أنا بأمان» تُرسل كرسالة قصيرة مخفية بين الأساور عبر شبكة الجوال،
 *   بدون إنترنت.
 * - عند استقبال رسالة من رقم موجود في القائمة، يظهر اسمه على الشاشة.
 *
 * صيغة الرسالة الحالية: "SW1 SAFE"
 * TODO(أمان): إضافة توقيع HMAC بمفتاح العائلة + عدّاد ضد إعادة الإرسال،
 * حتى لا يستطيع أحد تزوير «أنا بأمان».
 */
#include <string.h>
#include <zephyr/kernel.h>
#include <zephyr/logging/log.h>
#include <zephyr/settings/settings.h>
#include <modem/sms.h>

#include "family.h"
#include "state.h"

LOG_MODULE_REGISTER(family, LOG_LEVEL_INF);

#define SAFE_MSG "SW1 SAFE"
#define NAME_LEN 24
#define PHONE_LEN 16

struct member {
	char name[NAME_LEN];
	char phone[PHONE_LEN];
};

static struct {
	uint8_t count;
	struct member m[CONFIG_SIWAR_MAX_FAMILY];
} fam;

/* ---------------- الحفظ داخل السوار ---------------- */

static int fam_set(const char *key, size_t len, settings_read_cb read_cb, void *cb_arg)
{
	if (strcmp(key, "list") == 0 && len == sizeof(fam)) {
		ssize_t r = read_cb(cb_arg, &fam, sizeof(fam));

		return r < 0 ? (int)r : 0;
	}
	return -ENOENT;
}

SETTINGS_STATIC_HANDLER_DEFINE(siwar, "siwar", NULL, fam_set, NULL, NULL);

static int fam_save(void)
{
	return settings_save_one("siwar/list", &fam, sizeof(fam));
}

/* آخر ٩ أرقام تكفي للمطابقة بين 05XXXXXXXX و +9665XXXXXXXX */
static const char *tail9(const char *p)
{
	size_t n = strlen(p);

	return n > 9 ? p + n - 9 : p;
}

static int find(const char *phone)
{
	for (int i = 0; i < fam.count; i++) {
		if (strcmp(tail9(fam.m[i].phone), tail9(phone)) == 0) {
			return i;
		}
	}
	return -1;
}

int family_add(const char *name, const char *phone)
{
	if (find(phone) >= 0) {
		return -EEXIST;
	}
	if (fam.count >= CONFIG_SIWAR_MAX_FAMILY) {
		return -ENOMEM;
	}
	struct member *m = &fam.m[fam.count++];

	strncpy(m->name, name, NAME_LEN - 1);
	m->name[NAME_LEN - 1] = '\0';
	strncpy(m->phone, phone, PHONE_LEN - 1);
	m->phone[PHONE_LEN - 1] = '\0';
	LOG_INF("Family member added: %s", m->name);
	return fam_save();
}

int family_remove(const char *phone)
{
	int i = find(phone);

	if (i < 0) {
		return -ENOENT;
	}
	memmove(&fam.m[i], &fam.m[i + 1], (fam.count - i - 1) * sizeof(struct member));
	fam.count--;
	return fam_save();
}

int family_count(void)
{
	return fam.count;
}

/* ---------------- إرسال «أنا بأمان» ---------------- */

void family_broadcast_safe(void)
{
	if (fam.count == 0) {
		LOG_WRN("No family members to notify");
		return;
	}
	for (int i = 0; i < fam.count; i++) {
		int err = sms_send_text(fam.m[i].phone, SAFE_MSG);

		if (err) {
			/* TODO: إعادة المحاولة عند رجوع التغطية */
			LOG_ERR("Sending to %s failed (%d)", fam.m[i].name, err);
		} else {
			LOG_INF("'I am safe' sent to %s", fam.m[i].name);
		}
	}
}

/* ---------------- استقبال «أنا بأمان» من الأهل ---------------- */

static void sms_cb(struct sms_data *const data, void *context)
{
	if (data->type != SMS_TYPE_DELIVER || data->payload == NULL) {
		return;
	}
	if (strncmp(data->payload, SAFE_MSG, strlen(SAFE_MSG)) != 0) {
		return; /* رسالة عادية، ليست من نظام السوار */
	}
	const char *from = data->header.deliver.originating_address.address_str;
	int i = find(from);

	if (i < 0) {
		LOG_WRN("'I am safe' from unknown number ignored");
		return;
	}
	struct siwar_event ev = { .type = EV_FAMILY_SAFE };

	strncpy(ev.name, fam.m[i].name, sizeof(ev.name) - 1);
	state_post(&ev);
}

int family_init(void)
{
	int err = settings_subsys_init();

	if (err) {
		LOG_ERR("Settings init failed (%d)", err);
		return err;
	}
	settings_load_subtree("siwar");

	if (fam.count == 0 && strlen(CONFIG_SIWAR_DEV_FAMILY_PHONE) > 0) {
		family_add(CONFIG_SIWAR_DEV_FAMILY_NAME, CONFIG_SIWAR_DEV_FAMILY_PHONE);
	}
	LOG_INF("Family members stored: %d", fam.count);

	int handle = sms_register_listener(sms_cb, NULL);

	if (handle < 0) {
		LOG_ERR("SMS listener failed (%d)", handle);
		return handle;
	}
	return 0;
}
```

## src/family.h
```c
/*
 * السوار الوطني - قائمة الأهل ورسائل «أنا بأمان»
 */
#ifndef SIWAR_FAMILY_H
#define SIWAR_FAMILY_H

int family_init(void);

/* إدارة القائمة (ستُستدعى من تطبيق الجوال عبر البلوتوث لاحقًا) */
int family_add(const char *name, const char *phone);
int family_remove(const char *phone);
int family_count(void);

/* يرسل «أنا بأمان» لكل الأهل */
void family_broadcast_safe(void);

#endif
```

## src/state.c
```c
/*
 * السوار الوطني - آلة الحالات
 *
 *  IDLE --زر--> AWAKE --١٠ث--> IDLE
 *  أي حالة --إنذار--> ALERT
 *  ALERT --إغلاق--> ALERT_MUTED
 *  ALERT / ALERT_MUTED --أنا بأمان--> SAFE  (يرسل لأساور الأهل)
 *  ALERT / ALERT_MUTED / SAFE --زوال الخطر--> CLEAR --٣د--> IDLE
 *
 * ملاحظة مهمة: خارج الإنذار، الأزرار تضيء الشاشة فقط ولا ترسل شيئًا،
 * حتى لا تُرسل «أنا بأمان» بالخطأ.
 */
#include <string.h>
#include <zephyr/kernel.h>
#include <zephyr/logging/log.h>

#include "state.h"
#include "ui.h"
#include "family.h"

LOG_MODULE_REGISTER(state, LOG_LEVEL_INF);

K_MSGQ_DEFINE(ev_q, sizeof(struct siwar_event), 16, 4);

static enum siwar_state cur = ST_IDLE;

static void screen_timeout_fn(struct k_work *w) { state_post_simple(EV_SCREEN_TIMEOUT); }
static void clear_timeout_fn(struct k_work *w) { state_post_simple(EV_CLEAR_TIMEOUT); }
static K_WORK_DELAYABLE_DEFINE(screen_timer, screen_timeout_fn);
static K_WORK_DELAYABLE_DEFINE(clear_timer, clear_timeout_fn);

static const char *state_name(enum siwar_state s)
{
	switch (s) {
	case ST_IDLE: return "IDLE";
	case ST_AWAKE: return "AWAKE";
	case ST_ALERT: return "ALERT";
	case ST_ALERT_MUTED: return "ALERT_MUTED";
	case ST_SAFE: return "SAFE";
	case ST_CLEAR: return "CLEAR";
	}
	return "?";
}

static void enter(enum siwar_state next)
{
	LOG_INF("%s -> %s", state_name(cur), state_name(next));
	cur = next;

	switch (next) {
	case ST_IDLE:
		ui_light(UI_LIGHT_OFF);
		ui_vibrate_stop();
		ui_screen_off();
		break;
	case ST_AWAKE:
		ui_light(UI_LIGHT_OFF);
		ui_screen_status();
		k_work_reschedule(&screen_timer, K_SECONDS(CONFIG_SIWAR_SCREEN_TIMEOUT_S));
		break;
	case ST_ALERT:
		k_work_cancel_delayable(&screen_timer);
		k_work_cancel_delayable(&clear_timer);
		ui_light(UI_LIGHT_AMBER);
		ui_screen_text("Alert: go to a safe place"); /* «توجّه لمكان آمن» */
		ui_vibrate_alert();
		ui_sound_alert();
		break;
	case ST_ALERT_MUTED:
		ui_vibrate_stop();
		break;
	case ST_SAFE:
		ui_vibrate_stop();
		ui_light(UI_LIGHT_GREEN);
		ui_screen_text("Sent to your family"); /* «تم الإرسال لأهلك» */
		family_broadcast_safe();
		break;
	case ST_CLEAR:
		ui_vibrate_stop();
		ui_light(UI_LIGHT_GREEN);
		ui_screen_text("All clear"); /* «زال الخطر» */
		ui_vibrate_short();
		k_work_reschedule(&clear_timer, K_SECONDS(CONFIG_SIWAR_CLEAR_HOLD_S));
		break;
	}
}

static void handle(const struct siwar_event *ev)
{
	/* أحداث تعمل في كل الحالات */
	if (ev->type == EV_ALERT) {
		enter(ST_ALERT);
		return;
	}
	if (ev->type == EV_FAMILY_SAFE) {
		LOG_INF("Family member safe: %s", ev->name);
		ui_family_safe(ev->name);
		ui_vibrate_short();
		if (cur == ST_IDLE) {
			enter(ST_AWAKE);
		}
		return;
	}

	switch (cur) {
	case ST_IDLE:
	case ST_AWAKE:
		if (ev->type == EV_BTN_SAFE || ev->type == EV_BTN_DISMISS) {
			enter(ST_AWAKE); /* يعيد مؤقت الـ١٠ ثوانٍ */
		} else if (ev->type == EV_SCREEN_TIMEOUT && cur == ST_AWAKE) {
			enter(ST_IDLE);
		}
		break;

	case ST_ALERT:
	case ST_ALERT_MUTED:
		if (ev->type == EV_BTN_SAFE) {
			enter(ST_SAFE);
		} else if (ev->type == EV_BTN_DISMISS && cur == ST_ALERT) {
			enter(ST_ALERT_MUTED);
		} else if (ev->type == EV_ALL_CLEAR) {
			enter(ST_CLEAR);
		}
		break;

	case ST_SAFE:
		if (ev->type == EV_ALL_CLEAR) {
			enter(ST_CLEAR);
		}
		break;

	case ST_CLEAR:
		if (ev->type == EV_CLEAR_TIMEOUT) {
			enter(ST_IDLE);
		}
		break;
	}
}

int state_post(const struct siwar_event *ev)
{
	return k_msgq_put(&ev_q, ev, K_NO_WAIT);
}

int state_post_simple(enum siwar_event_type type)
{
	struct siwar_event ev = { .type = type };

	return state_post(&ev);
}

enum siwar_state state_get(void)
{
	return cur;
}

static void state_thread(void)
{
	struct siwar_event ev;

	while (true) {
		k_msgq_get(&ev_q, &ev, K_FOREVER);
		handle(&ev);
	}
}

K_THREAD_DEFINE(state_tid, 2048, state_thread, NULL, NULL, NULL, 5, 0, 0);

void state_init(void)
{
	enter(ST_IDLE);
}
```

## src/state.h
```c
/*
 * السوار الوطني - آلة الحالات
 * كل ما يحدث في السوار يصل هنا كـ "حدث"، وهذا الملف يقرر ماذا يفعل السوار.
 */
#ifndef SIWAR_STATE_H
#define SIWAR_STATE_H

#include <stdint.h>

enum siwar_state {
	ST_IDLE,         /* الشاشة مطفأة، لا يوجد إنذار */
	ST_AWAKE,        /* الشاشة مضاءة بعد ضغطة زر، تنطفئ بعد ١٠ ثوانٍ */
	ST_ALERT,        /* إنذار: اهتزاز + برتقالي */
	ST_ALERT_MUTED,  /* إنذار بعد إغلاق التنبيه: برتقالي بدون اهتزاز */
	ST_SAFE,         /* ضغط «أنا بأمان»، ينتظر زوال الخطر */
	ST_CLEAR,        /* زال الخطر: أخضر ٣ دقائق ثم ينطفئ */
};

enum siwar_event_type {
	EV_BTN_SAFE,          /* الزر الأيمن الأخضر */
	EV_BTN_DISMISS,       /* الزر الأيسر */
	EV_ALERT,             /* وصل إنذار وطني */
	EV_ALL_CLEAR,         /* وصل إشعار زوال الخطر */
	EV_SCREEN_TIMEOUT,    /* مرت ١٠ ثوانٍ بدون ضغط */
	EV_CLEAR_TIMEOUT,     /* مرت ٣ دقائق على الأخضر */
	EV_FAMILY_SAFE,       /* وصلت «أنا بأمان» من أحد الأهل */
};

struct siwar_event {
	enum siwar_event_type type;
	char name[24];        /* اسم الشخص في EV_FAMILY_SAFE */
};

void state_init(void);
int state_post(const struct siwar_event *ev);
int state_post_simple(enum siwar_event_type type);
enum siwar_state state_get(void);

#endif
```

## src/ui.c
```c
/*
 * السوار الوطني - واجهة السوار على لوحة التطوير Thingy:91 X
 *
 * الأزرار:
 *   الزر ١ = «أنا بأمان» (الأيمن الأخضر في السوار)
 *   الزر ٢ = «إغلاق التنبيه» (الأيسر)
 *   ضغط الزرين معًا ٣ ثوانٍ = إنذار تجريبي (وإن كان هناك إنذار: زوال خطر تجريبي)
 *
 * الإضاءة: نفترض LED1 أحمر و LED2 أخضر و LED3 أزرق في مكتبة DK.
 * إن اختلف الترتيب في اللوحة يُعدَّل هنا فقط.
 */
#include <zephyr/kernel.h>
#include <zephyr/logging/log.h>
#include <dk_buttons_and_leds.h>

#include "ui.h"
#include "state.h"

LOG_MODULE_REGISTER(ui, LOG_LEVEL_INF);

#define LED_R DK_LED1
#define LED_G DK_LED2
#define LED_B DK_LED3

#define BTN_SAFE    DK_BTN1_MSK
#define BTN_DISMISS DK_BTN2_MSK
#define COMBO_HOLD  K_SECONDS(3)

static enum ui_light current_light = UI_LIGHT_OFF;

/* ---------------- الإضاءة ---------------- */

static void leds_apply(enum ui_light c)
{
	dk_set_led(LED_R, c == UI_LIGHT_AMBER);
	dk_set_led(LED_G, c == UI_LIGHT_AMBER || c == UI_LIGHT_GREEN);
	dk_set_led(LED_B, 0);
}

void ui_light(enum ui_light color)
{
	current_light = color;
	leds_apply(color);
}

/* ---------------- الاهتزاز ----------------
 * لا يوجد محرك اهتزاز في لوحة التطوير، فنحاكيه بوميض الضوء.
 * في السوار الحقيقي: أوامر DRV2605L بالقوة المحفوظة في الإعدادات.
 */
static bool vib_on;
static bool vib_phase;

static void vib_fn(struct k_work *w);
static K_WORK_DELAYABLE_DEFINE(vib_work, vib_fn);

static void vib_fn(struct k_work *w)
{
	if (!vib_on) {
		leds_apply(current_light);
		return;
	}
	vib_phase = !vib_phase;
	leds_apply(vib_phase ? current_light : UI_LIGHT_OFF);
	k_work_reschedule(&vib_work, K_MSEC(400));
}

void ui_vibrate_alert(void)
{
	LOG_INF("[vibration] alert pattern ON");
	vib_on = true;
	k_work_reschedule(&vib_work, K_NO_WAIT);
}

void ui_vibrate_short(void)
{
	LOG_INF("[vibration] short pulse");
}

void ui_vibrate_stop(void)
{
	if (vib_on) {
		LOG_INF("[vibration] OFF");
	}
	vib_on = false;
	k_work_reschedule(&vib_work, K_NO_WAIT);
}

/* ---------------- الصوت ---------------- */

void ui_sound_alert(void)
{
	/* TODO(السوار الحقيقي): نغمة الطنّان حسب الإعداد، أو كتم الصوت */
	LOG_INF("[sound] alert tone");
}

/* ---------------- الشاشة ----------------
 * لا توجد شاشة في لوحة التطوير، فنكتب المحتوى في السجل.
 */
void ui_screen_off(void)
{
	LOG_INF("[screen] off");
}

void ui_screen_status(void)
{
	LOG_INF("[screen] battery %d%% | connected", ui_battery_percent());
}

void ui_screen_text(const char *text)
{
	LOG_INF("[screen] %s", text);
}

void ui_family_safe(const char *name)
{
	LOG_INF("[screen] %s is safe", name);
}

int ui_battery_percent(void)
{
	/* TODO: قراءة مقياس البطارية من nPM1300 */
	return 85;
}

/* ---------------- الأزرار ---------------- */

static uint32_t held;
static bool combo_fired;

static void combo_fn(struct k_work *w)
{
	combo_fired = true;
	enum siwar_state s = state_get();

	if (s == ST_ALERT || s == ST_ALERT_MUTED || s == ST_SAFE) {
		LOG_WRN("TEST: simulated all-clear");
		state_post_simple(EV_ALL_CLEAR);
	} else {
		LOG_WRN("TEST: simulated national alert");
		state_post_simple(EV_ALERT);
	}
}
static K_WORK_DELAYABLE_DEFINE(combo_work, combo_fn);

static void button_handler(uint32_t button_state, uint32_t has_changed)
{
	uint32_t pressed = button_state & has_changed;
	uint32_t released = ~button_state & has_changed;

	held |= pressed;

	if ((button_state & (BTN_SAFE | BTN_DISMISS)) == (BTN_SAFE | BTN_DISMISS)) {
		combo_fired = false;
		k_work_reschedule(&combo_work, COMBO_HOLD);
		return;
	}

	if (released) {
		k_work_cancel_delayable(&combo_work);
		bool was_combo = (held & (BTN_SAFE | BTN_DISMISS)) == (BTN_SAFE | BTN_DISMISS);

		if (button_state == 0) {
			if (!was_combo && !combo_fired) {
				if (held & BTN_SAFE) {
					state_post_simple(EV_BTN_SAFE);
				} else if (held & BTN_DISMISS) {
					state_post_simple(EV_BTN_DISMISS);
				}
			}
			held = 0;
			combo_fired = false;
		}
	}
}

int ui_init(void)
{
	int err = dk_leds_init();

	if (err) {
		LOG_ERR("LEDs init failed (%d)", err);
		return err;
	}
	err = dk_buttons_init(button_handler);
	if (err) {
		LOG_ERR("Buttons init failed (%d)", err);
		return err;
	}
	leds_apply(UI_LIGHT_OFF);
	return 0;
}
```

## src/ui.h
```c
/*
 * السوار الوطني - واجهة السوار (الضوء، الاهتزاز، الصوت، الشاشة، الأزرار)
 *
 * على لوحة التطوير Thingy:91 X: الضوء = الإضاءة الملونة، والاهتزاز والشاشة
 * تُعرض في السجل فقط لأنها غير موجودة في اللوحة.
 * على السوار الحقيقي: تُستبدل الدوال نفسها بمحرك الاهتزاز DRV2605L،
 * والطنّان، وشاشة AMOLED، دون تغيير باقي النظام.
 */
#ifndef SIWAR_UI_H
#define SIWAR_UI_H

enum ui_light {
	UI_LIGHT_OFF,
	UI_LIGHT_AMBER,
	UI_LIGHT_GREEN,
};

int ui_init(void);

void ui_light(enum ui_light color);

void ui_vibrate_alert(void);  /* اهتزاز متكرر للإنذار */
void ui_vibrate_short(void);  /* هزة خفيفة واحدة */
void ui_vibrate_stop(void);

void ui_sound_alert(void);

void ui_screen_off(void);
void ui_screen_status(void);           /* البطارية وحالة الاتصال */
void ui_screen_text(const char *text);
void ui_family_safe(const char *name); /* «فلان بأمان ✓» */

int ui_battery_percent(void);

#endif
```
